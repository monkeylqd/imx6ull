## uboot/board/ebyte/ebyte_imx6ull/Kconfig
```kconfig
if TARGET_EBYTE_MX6ULL

config SYS_BOARD
	default "ebyte_imx6ull"

config SYS_VENDOR
	default "ebyte"

config SYS_CONFIG_NAME
	default "ebyte_imx6ull"

config SYS_TEXT_BASE
	default 0x87800000
endif
```
